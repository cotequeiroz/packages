## libs/libstrophe/Config.in
```kconfig
choice
	depends on PACKAGE_libstrophe
	prompt "Select XML library"
	default libstrophe-expat

config libstrophe-expat
	bool "expat"

config libstrophe-libxml2
	bool "libxml2"

endchoice
```
